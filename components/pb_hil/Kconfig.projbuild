## components/pb_hil/Kconfig.projbuild
```kconfig
menu "DragonBreath hardware-in-loop"

config PB_HIL_CONSOLE
    bool "Enable the serial HIL command console"
    default n
    help
        Accept line-delimited JSON commands on the configured console UART and
        emit machine-readable DBHIL responses alongside normal ESP-IDF logs.
        This is intended for development and qualification images only.

config PB_HIL_DEVBOARD
    bool "Build for a safe ESP32-C3 development board"
    depends on PB_HIL_CONSOLE
    default n
    help
        Compile out every Panda mains GPIO write. Thermistors, zero-cross, and
        network state are supplied by the HIL console. Heater and fan outputs
        remain logical state only, so this image cannot energize Panda hardware.

endmenu
```

## components/pb_leds/Kconfig
```kconfig
menu "DragonBreath LEDs"

config PB_POWER_LED
    bool "Drive the front-panel Power LED (GPIO21) — disables serial console TX"
    default n
    help
      The front-panel "Power" LED is wired to GPIO21, which is also the UART0
      console TX pin. Enable this to drive it as the heating indicator (matching
      the stock firmware: on while heating). Doing so gives up runtime serial log
      output on TX (USB flashing still works — that uses the ROM bootloader).

      Leave DISABLED for development builds that need the serial console; enable
      it for release builds. The release CI pipeline sets it via sdkconfig.release.

endmenu
```

## sdkconfig.defaults
```kconfig
# DragonBreath default sdkconfig — ESP32-C3-MINI-1 (4MB flash)
CONFIG_IDF_TARGET="esp32c3"

# Flash / partitions
CONFIG_ESPTOOLPY_FLASHSIZE_4MB=y
CONFIG_PARTITION_TABLE_CUSTOM=y
CONFIG_PARTITION_TABLE_CUSTOM_FILENAME="partitions.csv"

# Size-optimize (the app slot is ~1.8MB; stock image is ~1.3MB)
CONFIG_COMPILER_OPTIMIZATION_SIZE=y

# Console on UART0 (CH340K USB-C bridge, GPIO21/20). The C3 native USB-Serial-JTAG
# is NOT usable here: its D-/D+ pads are GPIO18/19 and GPIO18 drives the heater SSR.
CONFIG_ESP_CONSOLE_UART_DEFAULT=y

# Task watchdog on — a hung control loop must not leave the heater energized.
# (pb_control subscribes via esp_task_wdt_add and pets it each loop.)
CONFIG_ESP_TASK_WDT_INIT=y
CONFIG_ESP_TASK_WDT_TIMEOUT_S=10
CONFIG_ESP_TASK_WDT_PANIC=y

# HTTP server: phone browsers send large header sets on POST — the 512B default
# request-header buffer overflows ("header fields are too long") when submitting
# the portal form. Bump it.
CONFIG_HTTPD_MAX_REQ_HDR_LEN=2048

# OTA rollback: a web-flashed image boots in PENDING_VERIFY and is only made
# permanent once app_main reaches a healthy state (esp_ota_mark_app_valid_...).
# A crash before that rolls back to the previous working app on reboot — matters
# for a mains heater that must never be bricked into an undefined SSR state.
CONFIG_BOOTLOADER_APP_ROLLBACK_ENABLE=y
```
